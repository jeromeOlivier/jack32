## boards/shields/Jack32/Kconfig.shield
```kconfig
# Jack32 Keyboard Configuration

config JACK32_KEYBOARD
    def_bool $(shields_list_contains,Jack32)

# Add more configuration options as needed
```

## boards/shields/Jack32v1/Kconfig.shield
```kconfig
# Jack32v1 Keyboard Configuration

config SHIELD_JACK32V1
    def_bool $(shields_list_contains,Jack32v1)

# Add more configuration options as needed
```
